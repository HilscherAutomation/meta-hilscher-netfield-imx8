/dts-v1/;
/plugin/;

#include <dt-bindings/gpio/gpio.h>
#include <dt-bindings/interrupt-controller/irq.h>
#include "../freescale/imx8mm-pinfunc.h"

/ {
	fragment@0 {
		target = <&regulator_uart1_mode>;
		__overlay__ {
			enable-active-low;
			status = "okay";
		};
	};
	fragment@1 {
		target = <&uart1>;
		__overlay__ {
			pinctrl-names = "default";
			pinctrl-0 = <&pinctrl_uart1_rs232 &pinctrl_uart1_gpio>;

			fsl,uart-has-rtsct;

			status = "okay";
		};
	};
};
