/dts-v1/;
/plugin/;

#include <dt-bindings/gpio/gpio.h>
#include <dt-bindings/interrupt-controller/irq.h>
#include "../freescale/imx8mm-pinfunc.h"

/ {
	fragment@0 {
		target = <&regulator_uart1_mode_rs485>;
		__overlay__ {
			status = "okay";
		};
	};
	fragment@1 {
		target = <&uart1_switchable>;
		__overlay__ {
			pinctrl-names = "default";
			pinctrl-0 = <&pinctrl_uart1_rs485 &pinctrl_uart1_gpio>;

			linux,rs485-enabled-at-boot-time;
			rs485-rts-active-high;
			rts-gpios = <&gpio4 24 GPIO_ACTIVE_LOW>;

			status = "okay";
		};
	};
};
