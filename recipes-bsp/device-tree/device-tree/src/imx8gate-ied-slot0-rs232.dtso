/dts-v1/;
/plugin/;

#include <dt-bindings/gpio/gpio.h>
#include <dt-bindings/interrupt-controller/irq.h>
#include "../freescale/imx8mm-pinfunc.h"

/ {
	fragment@0 {
		target-path = "/";
		__overlay__ {
			regulator-uart2-trm {
				compatible = "regulator-fixed";
				regulator-name = "uart2-trm";
				gpio = <&gpio5 12 GPIO_ACTIVE_LOW>;
				regulator-always-on;
				enable-active-low;
			};
		};
	};

	fragment@1 {
		target = <&uart2>;
		__overlay__ {
			pinctrl-names = "default";
			pinctrl-0 = <&pinctrl_uart2_sb_iotgimx8_ied &pinctrl_uart2_gpio_sb_iotgimx8_ied>;
			status = "okay";
		};
	};
};
